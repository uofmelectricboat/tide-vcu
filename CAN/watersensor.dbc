VERSION ""

NS_ :

BS_:

BU_:

BO_ 1650 WaterSensor: 8 Vector__XXX
 SG_ Watersensor1 : 0|1@1+ (1,0) [0|0] "V" Vector__XXX
 SG_ Watersensor2 : 1|1@1+ (1,0) [0|0] "V" Vector__XXX
